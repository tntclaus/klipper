## src/linux/Kconfig
```kconfig
# Kconfig settings for compiling and running the micro-controller code
# in a Linux process

if MACH_LINUX

config LINUX_SELECT
    bool
    default y
    select HAVE_GPIO_ADC
    select HAVE_GPIO_SPI
    select HAVE_GPIO_HARD_PWM
    select HAVE_GPIO_I2C
    select HAVE_GPIO_BITBANGING
    select HAVE_GPIO

config BOARD_DIRECTORY
    string
    default "linux"

config CLOCK_FREQ
    int
    default 50000000


choice
    prompt "GPIO Access"
    depends on LOW_LEVEL_OPTIONS
    config GPIO_GENERIC
        bool "Generic Linux"
    config GPIO_NATIVE_RPI3
        bool "Raspberry Pi 2/3"
#    config GPIO_NATIVE_RPI4
#        bool "Raspberry Pi 4"
endchoice



endif
```
